## kernel-4.14/drivers/misc/mediatek/sensors-1.0/accelerometer/lis2dw/Kconfig
```kconfig
config MTK_LIS2DW
	bool "LIS2DW for MediaTek package"
	default n
	help
		It supports different accelerometer sensor.
		If this option is set, it will support
		LIS2DW Accelerometer.
```
